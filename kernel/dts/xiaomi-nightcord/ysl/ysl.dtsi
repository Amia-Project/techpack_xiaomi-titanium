#include "pinctrl.dtsi"
#include "ysl-pinctrl.dtsi"
#include "android.dtsi"
#include "audio.dtsi"
#include "battery.dtsi"
#include "misc.dtsi"
#include "display.dtsi"
#include "fingerprint.dtsi"
#include "pmic.dtsi"
#include "touchscreen.dtsi"
#include "camera.dtsi"